## Kconfig
```kconfig
mainmenu "Renesas RZ Community BSP Configuration"

config KAS_BUILD_SYSTEM
	string
	default "openembedded"

menu "Yocto"
choice
	prompt "Select the Yocto version to use"
	default YOCTO_SCARTHGAP

	config YOCTO_KIRKSTONE
	bool "Yocto Kirkstone"
	help
		Select Yocto Kirkstone

	config KAS_INCLUDE_YOCTO_KIRKSTONE
	string
	depends on YOCTO_KIRKSTONE
	default "kas/yocto/kirkstone.yml"

	config YOCTO_SCARTHGAP
	bool "Yocto Scarthgap"
	help
		Select Yocto Scarthgap

	config KAS_INCLUDE_YOCTO_SCARTHGAP
	string
	depends on YOCTO_SCARTHGAP
	default "kas/yocto/scarthgap.yml"
endchoice
endmenu

config FAMILY_G2H
bool

config FAMILY_G2L
bool

menu "Machine"
choice
	prompt "Select the machine to build for"
	default MACHINE_SMARC-RZG2L

	config MACHINE_HIHOPE-RZG2H
	bool "hihope-rzg2h"
	select FAMILY_G2H
	help
		Select the Renesas RZ/G2H reference platform from HopeRun

	config KAS_INCLUDE_MACHINE_HIHOPE-RZG2H
	string
	depends on MACHINE_HIHOPE-RZG2H
	default "kas/machine/hihope-rzg2h.yml"

	config MACHINE_HIHOPE-RZG2M
	bool "hihope-rzg2m"
	select FAMILY_G2H
	help
		Select the Renesas RZ/G2M reference platform from HopeRun

	config KAS_INCLUDE_MACHINE_HIHOPE-RZG2M
	string
	depends on MACHINE_HIHOPE-RZG2M
	default "kas/machine/hihope-rzg2m.yml"

	config MACHINE_HIHOPE-RZG2N
	bool "hihope-rzg2n"
	select FAMILY_G2H
	help
		Select the Renesas RZ/G2N reference platform from HopeRun

	config KAS_INCLUDE_MACHINE_HIHOPE-RZG2N
	string
	depends on MACHINE_HIHOPE-RZG2N
	default "kas/machine/hihope-rzg2n.yml"

	config MACHINE_EK874
	bool "ek874"
	select FAMILY_G2H
	help
		Select the Renesas RZ/G2E reference platform from SiLinux

	config KAS_INCLUDE_MACHINE_EK874
	string
	depends on MACHINE_EK874
	default "kas/machine/ek874.yml"

	config MACHINE_SMARC-RZG2L
	bool "smarc-rzg2l"
	select FAMILY_G2L
	help
		Select the Renesas RZ/G2L reference platform

	config KAS_INCLUDE_MACHINE_SMARC-RZG2L
	string
	depends on MACHINE_SMARC-RZG2L
	default "kas/machine/smarc-rzg2l.yml"

	config MACHINE_SMARC-RZG2LC
	bool "smarc-rzg2lc"
	select FAMILY_G2L
	help
		Select the Renesas RZ/G2LC reference platform

	config KAS_INCLUDE_MACHINE_SMARC-RZG2LC
	string
	depends on MACHINE_SMARC-RZG2LC
	default "kas/machine/smarc-rzg2lc.yml"

	config MACHINE_SMARC-RZG2UL
	bool "smarc-rzg2ul"
	select FAMILY_G2L
	help
		Select the Renesas RZ/G2UL reference platform

	config KAS_INCLUDE_MACHINE_SMARC-RZG2UL
	string
	depends on MACHINE_SMARC-RZG2UL
	default "kas/machine/smarc-rzg2ul.yml"

endchoice
endmenu

menu "Image"
choice
	prompt "Select the image to build"
	default IMAGE_RENESAS_IMAGE_MINIMAL

	config IMAGE_RENESAS_IMAGE_MINIMAL
	bool "renesas-image-minimal"
	help
		Use a basic image based on core-image

	config KAS_INCLUDE_IMAGE_RENESAS_IMAGE_MINIMAL
	string
	depends on IMAGE_RENESAS_IMAGE_MINIMAL
	default "kas/image/renesas-image-minimal.yml"

	config IMAGE_RENESAS_IMAGE_DEMO
	depends on MACHINE_SMARC-RZG2L || MACHINE_SMARC-RZG2LC
	bool "renesas-image-demo"
	help
		Build a demo image including Weston/Wayland support.
		Currently only supported on smarc-rzg2l and smarc-rzg2lc.

	config KAS_INCLUDE_IMAGE_RENESAS_IMAGE_DEMO
	string
	depends on IMAGE_RENESAS_IMAGE_DEMO
	default "kas/image/renesas-image-demo.yml"
endchoice
endmenu

menu "Linux"
choice
	prompt "Select the Linux kernel version to use"
	default KERNEL_CIP_6.1

	config KERNEL_RENESAS_5.10
	bool "Renesas v5.10"
	help
		Use the Linux kernel from the Renesas BSP based on CIP SLTS v5.10

	config KAS_INCLUDE_KERNEL_RENESAS_5.10
	string
	depends on KERNEL_RENESAS_5.10
	default "kas/kernel/renesas-5.10.yml"

	config KERNEL_CIP_5.10
	bool "CIP SLTS v5.10"
	help
		Use the CIP SLTS Linux kernel v5.10

	config KAS_INCLUDE_KERNEL_CIP_5.10
	string
	depends on KERNEL_CIP_5.10
	default "kas/kernel/cip-5.10.yml"

	config KERNEL_CIP_6.1
	bool "CIP SLTS v6.1"
	help
		Use the CIP SLTS Linux kernel v6.1

	config KAS_INCLUDE_KERNEL_CIP_6.1
	string
	depends on KERNEL_CIP_6.1
	default "kas/kernel/cip-6.1.yml"

	config KERNEL_LTS_6.6
	bool "LTS v6.6"
	help
		Use the latest LTS v6.6 kernel.

		The meta-linux-mainline layer is used to provide the kernel
		recipe.

	config KAS_INCLUDE_KERNEL_LTS_6.6
	string
	depends on KERNEL_LTS_6.6
	default "kas/kernel/lts-6.6.yml"

	config KERNEL_MAINLINE
	bool "Mainline"
	help
		Use the latest mainline kernel - note that this may be a
		pre-release kernel. This option is intended for development and
		testing, not production use.

		The meta-linux-mainline layer is used to provide the mainline
		kernel recipe.

	config KAS_INCLUDE_KERNEL_MAINLINE
	string
	depends on KERNEL_MAINLINE
	default "kas/kernel/mainline.yml"
endchoice
endmenu

menu "Bootloaders"
	menu "U-Boot"
	choice
		prompt "Select the U-Boot version to use"
		default UBOOT_MAINLINE_2024.10 if FAMILY_G2H
		default UBOOT_RENESAS_2021.10

		config UBOOT_RENESAS_2021.10
		bool "Renesas v2021.10"
		help
			Use the U-Boot from the Renesas BSP based on v2021.10

		config KAS_INCLUDE_UBOOT_RENESAS_2021.10
		string
		depends on UBOOT_RENESAS_2021.10
		default "kas/u-boot/renesas-2021.10.yml"

		config UBOOT_MAINLINE_2024.10
		bool "Mainline v2024.10"
		depends on FAMILY_G2H
		help
			Use mainline U-Boot v2024.10

		config KAS_INCLUDE_UBOOT_MAINLINE_2024.10
		string
		depends on UBOOT_MAINLINE_2024.10
		default "kas/u-boot/mainline-2024.10.yml"
	endchoice
	endmenu

	menu "Trusted-Firmware-A"
	choice
		prompt "Select the Trusted-Firmware-A version to use"
		default TFA_MAINLINE_2.10.8 if FAMILY_G2H
		default TFA_RENESAS_2.9.0

		config TFA_RENESAS_2.9.0
		bool "Renesas v2.9.0"
		help
			Use the Trusted-Firmware-A v2.9.0 from the Renesas BSP

		config KAS_INCLUDE_TFA_RENESAS_2.9.0
		string
		depends on TFA_RENESAS_2.9.0
		default "kas/trusted-firmware-a/renesas-2.9.0.yml"

		config TFA_MAINLINE_2.10.8
		bool "Mainline v2.10.8 LTS"
		depends on FAMILY_G2H
		help
			Use mainline Trusted-Firmware-A v2.10.8 LTS

		config KAS_INCLUDE_TFA_MAINLINE_2.10.8
		string
		depends on TFA_MAINLINE_2.10.8
		default "kas/trusted-firmware-a/mainline-2.10.8.yml"
	endchoice
	endmenu
endmenu

menu "SDK"
	config SET_SDKMACHINE
	bool "Set value for SDKMACHINE"
	default n
	help
		Set the machine that the SDK is built to be installed on.
		Available options provided by OpenEmbedded-Core are: aarch64,
		i586, i686, ppc64, ppc64le, and x86_64.

	config SDKMACHINE
	depends on SET_SDKMACHINE
	string "SDKMACHINE"
	default "x86_64"
	help
		Set the machine that the SDK is built to be installed on.
		Available options provided by OpenEmbedded-Core are: aarch64,
		i586, i686, ppc64, ppc64le, and x86_64.
endmenu

menu "Other"
	config OPT_DEBUG
	bool "Debug"
	default y
	help
		Enable the debug-tweaks image feature that enabled features
		helpfull for development (e.g. allows root logins, logins
		without passwords (including root ones), and enables
		post-installation logging).

		Also include a number of packages useful for hardware debugging
		such as can-utils and i2c-tools.

	config KAS_INCLUDE_OPT_DEBUG
	string
	depends on OPT_DEBUG
	default "kas/opt/debug.yml"
endmenu
```

## meta-rz-bsp/conf/layer.conf
```bitbake
# We have a conf and classes directory, add to BBPATH
BBPATH .= ":${LAYERDIR}"

# We have recipes-* directories, add to BBFILES
BBFILES += "${LAYERDIR}/recipes-*/*/*.bb \
            ${LAYERDIR}/recipes-*/*/*.bbappend"

BBFILE_COLLECTIONS += "meta-rz-bsp"
BBFILE_PATTERN_meta-rz-bsp = "^${LAYERDIR}/"
BBFILE_PRIORITY_meta-rz-bsp = "6"

LAYERDEPENDS_meta-rz-bsp = "core meta-arm"
LAYERSERIES_COMPAT_meta-rz-bsp = "kirkstone scarthgap"

# Custom licenses
LICENSE_PATH += "${LAYERDIR}/files/custom-licenses"
```

## meta-rz-bsp/conf/machine/ek874.conf
```bitbake
#@TYPE: Machine
#@NAME: ek874
#@DESCRIPTION: Reference machine configuration for the RZ/G2E reference platform

require conf/machine/include/arm/armv8a/tune-cortexa53.inc
require include/rzg2h-family.inc

# Linux kernel configuration
KERNEL_DEVICETREE ?= "renesas/r8a774c0-ek874.dtb"

# U-Boot configuration
UBOOT_MACHINE ?= "silinux_ek874_defconfig"

# TF-A configuration
TFA_EXTRA_OEMAKE ?= " \
	LSI=G2E \
	RCAR_SA0_SIZE=0 \
	RCAR_DRAM_DDR3L_MEMDUAL=1 \
	AVS_SETTING_ENABLE=0 \
	RCAR_SYSTEM_SUSPEND=0 \
	RCAR_LOSSY_ENABLE=1 \
	RCAR_RPC_HYPERFLASH_LOCKED=0 \
	RCAR_SA6_TYPE=0 \
	INIT_UNUSED_NS_EL2=1 \
"

# Flash Writer configuration
FLASH_WRITER_BOARD ?= "EK874"
```

## meta-rz-bsp/conf/machine/hihope-rzg2h.conf
```bitbake
#@TYPE: Machine
#@NAME: hihope-rzg2h
#@DESCRIPTION: Reference machine configuration for the RZ/G2H reference platform

require conf/machine/include/arm/armv8a/tune-cortexa57-cortexa53.inc
require include/rzg2h-family.inc

# Linux kernel configuration
KERNEL_DEVICETREE ?= "renesas/r8a774e1-hihope-rzg2h-ex.dtb"

# U-Boot configuration
UBOOT_MACHINE ?= "hihope_rzg2_defconfig"

# TF-A configuration
TFA_EXTRA_OEMAKE ?= " \
	LSI=G2H \
	RCAR_DRAM_SPLIT=2 \
	RCAR_DRAM_LPDDR4_MEMCONF=1 \
	RCAR_DRAM_CHANNEL=5 \
	AVS_SETTING_ENABLE=0 \
	RCAR_SYSTEM_SUSPEND=0 \
	RCAR_LOSSY_ENABLE=1 \
	RCAR_RPC_HYPERFLASH_LOCKED=0 \
	RCAR_SA6_TYPE=0 \
	INIT_UNUSED_NS_EL2=1 \
"

# Flash Writer configuration
FLASH_WRITER_BOARD ?= "HIHOPE"
```

## meta-rz-bsp/conf/machine/hihope-rzg2n.conf
```bitbake
#@TYPE: Machine
#@NAME: hihope-rzg2n
#@DESCRIPTION: Reference machine configuration for the RZ/G2N reference platform

require conf/machine/include/arm/armv8a/tune-cortexa57.inc
require include/rzg2h-family.inc

# Linux kernel configuration
KERNEL_DEVICETREE ?= "renesas/r8a774b1-hihope-rzg2n-ex.dtb"

# U-Boot configuration
UBOOT_MACHINE ?= "hihope_rzg2_defconfig"

# TF-A configuration
TFA_EXTRA_OEMAKE ?= " \
	LSI=G2N \
	AVS_SETTING_ENABLE=0 \
	RCAR_SYSTEM_SUSPEND=0 \
	RCAR_LOSSY_ENABLE=1 \
	RCAR_RPC_HYPERFLASH_LOCKED=0 \
	RCAR_SA6_TYPE=0 \
	INIT_UNUSED_NS_EL2=1 \
"

# Flash Writer configuration
FLASH_WRITER_BOARD ?= "HIHOPE"
```

## meta-rz-bsp/conf/machine/include/rz-common.inc
```bitbake
require conf/machine/include/soc-family.inc

MACHINE_FEATURES = "serial screen usbhost"
IMAGE_FSTYPES:append = " tar.gz"
SERIAL_CONSOLES = "115200;ttySC0"

# Linux kernel configuration
PREFERRED_PROVIDER_virtual/kernel ?= "linux-cip"
PREFERRED_VERSION_linux-cip ?= "6.1%"
KERNEL_IMAGETYPE ?= "Image"

# Yocto Scarthgap has increased OLDEST_KERNEL to 5.15 but we have the option to
# build 5.10 with this meta-layer. Override OLDEST_KERNEL to allow this
OLDEST_KERNEL = "5.10"

# Other dependencies that aren't included in the rootfs
EXTRA_IMAGEDEPENDS += " \
	flash-writer \
	virtual/bootloader \
	virtual/trusted-firmware-a \
"
```

## meta-rz-bsp/conf/machine/include/rzg2h-family.inc
```bitbake
require rz-common.inc

SOC_FAMILY = "rzg2h-family"

# U-Boot configuration
PREFERRED_PROVIDER_virtual/bootloader ?= "u-boot"
PREFERRED_VERSION_u-boot ?= "2024.10%"

# TF-A configuration
PREFERRED_PROVIDER_virtual/trusted-firmware-a ?= "trusted-firmware-a"
PREFERRED_VERSION_trusted-firmware-a ?= "2.10.5"
TFA_PLATFORM ?= "rzg"
TFA_BUILD_TARGET = "bl2 bl31 rzg"
TFA_INSTALL_TARGET = ""
```

## meta-rz-bsp/conf/machine/include/rzg2l-family.inc
```bitbake
require conf/machine/include/arm/armv8-2a/tune-cortexa55.inc
require rz-common.inc

SOC_FAMILY = "rzg2l-family"

# U-Boot configuration
PREFERRED_PROVIDER_virtual/bootloader ?= "u-boot-renesas"
PREFERRED_VERSION_u-boot-renesas ?= "2021.10%"

# TF-A configuration
PREFERRED_PROVIDER_virtual/trusted-firmware-a ?= "trusted-firmware-a-renesas"
PREFERRED_VERSION_trusted-firmware-a-renesas ?= "2.9.0"
TFA_BUILD_TARGET = "bl2 bl31 fip"
TFA_INSTALL_TARGET = ""
TFA_UBOOT = "1"

IMAGE_FSTYPES:append = " wic.gz wic.bmap"
WKS_FILE = "rzg2l-sdcard.wks"
```

## meta-rz-bsp/conf/machine/smarc-rzg2l.conf
```bitbake
#@TYPE: Machine
#@NAME: smarc-rzg2l
#@DESCRIPTION: Reference machine configuration for the RZ/G2L reference platform

require include/rzg2l-family.inc

# Linux kernel configuration
KERNEL_DEVICETREE_BASENAME ?= "r9a07g044l2-smarc"

# U-Boot configuration
UBOOT_MACHINE ?= "smarc-rzg2l_defconfig"

# TF-A configuration
TFA_PLATFORM ?= "g2l"
TFA_EXTRA_OEMAKE ?= " \
	BOARD=smarc_pmic_2 \
"

# Flash Writer configuration
FLASH_WRITER_BOARD ?= "RZG2L_SMARC_PMIC"
```

## meta-rz-bsp/conf/machine/smarc-rzg2lc.conf
```bitbake
#@TYPE: Machine
#@NAME: smarc-rzg2lc
#@DESCRIPTION: Reference machine configuration for the RZ/G2LC reference platform

require include/rzg2l-family.inc

# Linux kernel configuration
KERNEL_DEVICETREE ?= "renesas/r9a07g044c2-smarc.dtb"

# U-Boot configuration
UBOOT_MACHINE ?= "smarc-rzg2lc_defconfig"

# TF-A configuration
TFA_PLATFORM = "g2l"
TFA_EXTRA_OEMAKE = " \
	BOARD=smarc_1 \
"
```

## meta-rz-bsp/conf/machine/smarc-rzg2ul.conf
```bitbake
#@TYPE: Machine
#@NAME: smarc-rzg2ul
#@DESCRIPTION: Reference machine configuration for the RZ/G2UL reference platform

require include/rzg2l-family.inc

# Linux kernel configuration
KERNEL_DEVICETREE ?= "renesas/r9a07g043u11-smarc.dtb"

# U-Boot configuration
UBOOT_MACHINE ?= "smarc-rzg2ul_defconfig"

# TF-A configuration
TFA_PLATFORM = "g2ul"
TFA_EXTRA_OEMAKE = " \
	BOARD=g2ul_smarc SOC_TYPE=1 SPI_FLASH=AT25QL128A \
"

# Flash Writer configuration
FLASH_WRITER_BOARD ?= "RZG2UL_SMARC"
```

## meta-rz-bsp/conf/machine/smarc-rzv2l.conf
```bitbake
#@TYPE: Machine
#@NAME: smarc-rzv2l
#@DESCRIPTION: Reference machine configuration for the RZ/V2L reference platform

require include/rzg2l-family.inc

# Linux kernel configuration
KERNEL_DEVICETREE ?= "renesas/r9a07g054l2-smarc.dtb"

# U-Boot configuration
UBOOT_MACHINE ?= "smarc-rzv2l_defconfig"

# TF-A configuration
TFA_PLATFORM ?= "v2l"
TFA_EXTRA_OEMAKE ?= " \
	BOARD=smarc_pmic_2 \
"

# Flash Writer configuration
FLASH_WRITER_BOARD ?= "RZV2L_SMARC_PMIC"
```

## meta-rz-bsp/wic/rzg2l-sdcard.wks
```
# short-description: Create SD card image for RZ/G2L family SoC
# long-description:  Creates a bootable SD card image including u-boot/atf + rootfs for Renesas RZ/G2L family SoC

# Memory Layout:
# | Sector | Function |
# |      0 | MBR
# |      1 | boot parameters, primary
# |      2 | boot parameters, fallback 1
# |      3 | boot parameters, fallback 2
# |      4 | boot parameters, fallback 3
# |      5 | boot parameters, fallback 4
# |      6 | boot parameters, fallback 5
# |      7 | boot parameters, fallback 6
# |      8 | bl2 (atf), primary
# |  N + 8 | bl2 (atf), fallback 1 (N = size of bl2)
# | 2N + 8 | bl2 (atf), fallback 2 (N = size of bl2)
# | 3N + 8 | bl2 (atf), fallback 3 (N = size of bl2)
# | 4N + 8 | bl2 (atf), fallback 4 (N = size of bl2)
# | 5N + 8 | bl2 (atf), fallback 5 (N = size of bl2)
# | 6N + 8 | bl2 (atf), fallback 6 (N = size of bl2)
# |    128 | u-boot + bl31 (defined in ATF RZG2L_SD_FIP_BASE)
# |    ... | reserved for u-boot
# |   8192 | first partition

part bootparam --source rawcopy --sourceparams="file=bp-${MACHINE}.bin"  --ondisk mmcblk --no-table --offset 1s
part bl2       --source rawcopy --sourceparams="file=bl2-${MACHINE}.bin" --ondisk mmcblk --no-table --offset 8s
part u-boot    --source rawcopy --sourceparams="file=fip-${MACHINE}.bin" --ondisk mmcblk --no-table --offset 128s

part /         --source rootfs --ondisk mmcblk0 --fstype=ext4 --use-uuid --align 4 --label rootfs --offset 8192s
```
